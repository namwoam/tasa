## assignment/task1/leon-buildroot/boot/mkprom2/Config.in
```kconfig
# Avoid mkprom2 appearing to be a subcomponent of mklinuximg
config BR2_TARGET_MKPROM2_AVOID_NESTING
       bool

config BR2_TARGET_MKPROM2
	bool "mkprom2"
	depends on (BR2_sparc_leon3 || BR2_sparc_leon5) && BR2_LINUX_KERNEL && \
		BR2_LINUX_KERNEL_VMLINUX && BR2_TARGET_MKLINUXIMG
	help
	  MKPROM2 is a bootloader for LEON SPARC32 systems.

if BR2_TARGET_MKPROM2
choice
	prompt "MKPROM2 Version"
	help
	  Select the specific MKPROM2 version you want to use

config BR2_TARGET_MKPROM2_LATEST_VERSION
	bool "2.0.69"

config BR2_TARGET_MKPROM2_CUSTOM_VERSION
	bool "Custom version"
	help
	  This option allows to use a specific official versions

config BR2_TARGET_MKPROM2_CUSTOM_TARBALL
	bool "Custom tarball"

config BR2_TARGET_MKPROM2_CUSTOM_GIT
	bool "Custom Git repository"

endchoice

config BR2_TARGET_MKPROM2_CUSTOM_VERSION_VALUE
	string "MKPROM2 version"
	depends on BR2_TARGET_MKPROM2_CUSTOM_VERSION

config BR2_TARGET_MKPROM2_CUSTOM_TARBALL_LOCATION
	string "URL of custom MKPROM2 tarball"
	depends on BR2_TARGET_MKPROM2_CUSTOM_TARBALL

if BR2_TARGET_MKPROM2_CUSTOM_GIT

config BR2_TARGET_MKPROM2_CUSTOM_REPO_URL
	string "URL of custom repository"

config BR2_TARGET_MKPROM2_CUSTOM_REPO_VERSION
	string "Custom repository version"
	help
	  Revision to use in the typical format used by Git,
	  e.g. a SHA ID, a tag, or branch.

endif

config BR2_TARGET_MKPROM2_VERSION
	string
	default "2.0.69"	if BR2_TARGET_MKPROM2_LATEST_VERSION
	default BR2_TARGET_MKPROM2_CUSTOM_VERSION_VALUE \
		if BR2_TARGET_MKPROM2_CUSTOM_VERSION
	default "custom"	if BR2_TARGET_MKPROM2_CUSTOM_TARBALL
	default BR2_TARGET_MKPROM2_CUSTOM_REPO_VERSION \
		if BR2_TARGET_MKPROM2_CUSTOM_GIT

config BR2_TARGET_MKPROM2_FREQ
	int "System frequency in MHz"
	default 50
	help
	  System frequency to set up timers.

config BR2_TARGET_MKPROM2_ARGS
       string "Arguments to pass to the mkprom2 call"
       default ""

endif
```

## assignment/task1/leon-buildroot/configs/gaisler_ut700_defconfig
```kconfig
BR2_sparc=y
BR2_sparc_leon3=y
BR2_GLOBAL_PATCH_DIR="board/gaisler/leon-common/patches"
BR2_TOOLCHAIN_EXTERNAL=y
BR2_SPARC_ERRATA_WORKAROUND_UT700=y
BR2_ROOTFS_POST_IMAGE_SCRIPT="board/gaisler/leon-common/post-image.sh"
BR2_LINUX_KERNEL=y
BR2_LINUX_KERNEL_CUSTOM_VERSION=y
BR2_LINUX_KERNEL_CUSTOM_VERSION_VALUE="5.10.175"
BR2_LINUX_KERNEL_DEFCONFIG="leon"
BR2_LINUX_KERNEL_CONFIG_FRAGMENT_FILES="board/gaisler/ut700/linux.fragment"
BR2_LINUX_KERNEL_VMLINUX=y
BR2_TARGET_ROOTFS_INITRAMFS=y
# BR2_TARGET_ROOTFS_TAR is not set
BR2_TARGET_MKLINUXIMG=y
```

## assignment/task1/leon-buildroot/package/glibc/Config.in
```kconfig
if BR2_TOOLCHAIN_BUILDROOT_GLIBC

comment "Glibc Options"

choice
	prompt "Glibc Version"
	default BR2_PACKAGE_GLIBC_UPSTREAM

config BR2_PACKAGE_GLIBC_UPSTREAM
	bool "Use version upstream Buildroot uses"

config BR2_PACKAGE_GLIBC_GAISLER_LEON_2_31
	bool "Use Gaisler GLIBC 2.31 supporting errata fixes for certain LEON components"
	depends on (BR2_sparc_leon3 || BR2_sparc_leon5) && BR2_TOOLCHAIN_HAS_GCC_LEON_MFIX_DEFINES
	select BR2_TOOLCHAIN_HAS_GLIBC_LEON_MFIX
	help
	  Use Gaisler GLIBC 2.31 supporting errata fixes for certain LEON components

endchoice

config BR2_PACKAGE_GLIBC
	bool
	default y
	select BR2_PACKAGE_LINUX_HEADERS
	select BR2_TOOLCHAIN_HAS_SSP if BR2_PACKAGE_HOST_BINUTILS_SUPPORTS_CFI
	help
	  https://www.gnu.org/software/libc/

config BR2_PACKAGE_GLIBC_KERNEL_COMPAT
	bool "Enable compatibility shims to run on older kernels"
	help
	  Say 'y' here if you plan on running your system on a kernel
	  older than the version used for the toolchain headers.

	  Enabling those compatibility shims may generate a slightly
	  bigger and slightly slower glibc library.

	  The oldest supported kernel version depends on the
	  architecture.

config BR2_PACKAGE_GLIBC_UTILS
	bool "Install glibc utilities"
	help
	  Enabling this option will compile and install the getconf,
	  ldconfig, ldd and locale glibc utilities for the target.

endif # BR2_TOOLCHAIN_BUILDROOT_GLIBC
```

## assignment/task1/leon-buildroot/toolchain/toolchain-external/toolchain-external-gaisler-sparc/Config.in
```kconfig
config BR2_TOOLCHAIN_EXTERNAL_GAISLER_SPARC
	bool "Gaisler SPARC/LEON toolchains"
	help
	   Gaisler SPARC/LEON toolchains
```
